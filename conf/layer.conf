## conf/layer.conf
```bitbake
BBPATH .= ":${LAYERDIR}"

BBFILES += "\
            ${LAYERDIR}/recipes-*/*/*.bb \
            ${LAYERDIR}/recipes-*/*/*.bbappend \
           "

BBFILE_COLLECTIONS += "plumewifi"
BBFILE_PATTERN_plumewifi = "^${LAYERDIR}/"
BBFILE_PRIORITY_plumewifi = "25"

LICENSE_PATH += "${LAYERDIR}/licenses"

LAYERSERIES_COMPAT_plumewifi = "rocko sumo thud warrior zeus dunfell"

# ----------------------------------------------------------------------------

PLUME_GIT ?= "git://git@github.com/plume-design"

# ----------------------------------------------------------------------------

PREFERRED_VERSION_opensync ?= "1.4.0"

# ----------------------------------------------------------------------------

PREFERRED_VERSION_jansson = "2.13.1"
PREFERRED_VERSION_libev = "4.19"
PREFERRED_VERSION_mosquitto = "1.4.15"

# ----------------------------------------------------------------------------

OPENVSWITCH_VERSION = "2.3.90"

PREFERRED_VERSION_openvswitch = "${OPENVSWITCH_VERSION}%"
PREFERRED_VERSION_openvswitch-native = "${OPENVSWITCH_VERSION}%"
PREFERRED_VERSION_openvswitch-nativesdk = "${OPENVSWITCH_VERSION}%"

# ----------------------------------------------------------------------------

# Note: protobuf and protobuf-c versions generally need to be updated together.
# Select the older versions of protobuf and protobuf-c for OpenSync 1.4.0 (otherwise use the newer recipes).

PROTOBUF_VERSION ?= "${@bb.utils.contains('PREFERRED_VERSION_opensync', '1.4.0', '2.6.1', '3.5.1', d)}"
PROTOBUFC_VERSION ?= "${@bb.utils.contains('PREFERRED_VERSION_opensync', '1.4.0', '1.1.1', '1.3.0', d)}"

PREFERRED_VERSION_protobuf = "${PROTOBUF_VERSION}%"
PREFERRED_VERSION_protobuf-native = "${PROTOBUF_VERSION}%"
PREFERRED_VERSION_protobuf-nativesdk = "${PROTOBUF_VERSION}%"
PREFERRED_VERSION_protobuf-c = "${PROTOBUFC_VERSION}%"
PREFERRED_VERSION_protobuf-c-native = "${PROTOBUFC_VERSION}%"
PREFERRED_VERSION_protobuf-c-nativesdk = "${PROTOBUFC_VERSION}%"

# ----------------------------------------------------------------------------

# Prevent build failures due to missing python-protobuf dependency when
# building with distros which enable ptest by default (e.g. poky).

PTEST_ENABLED_pn-protobuf = ""

# ----------------------------------------------------------------------------

# plume-pml needs "cksum". Try to make the host version available.

HOSTTOOLS += "cksum"

# ----------------------------------------------------------------------------
```
